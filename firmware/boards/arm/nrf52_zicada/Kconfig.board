## firmware/boards/arm/nrf52_zicada/Kconfig.board
```kconfig
# Copyright (c) 2024 Nordic Semiconductor ASA
# SPDX-License-Identifier: Apache-2.0

config BOARD_NRF52_ZICADA
	bool "nRF52840 Zicada Zigbee Node"
	depends on SOC_NRF52840_QIAA
```

## firmware/boards/arm/nrf52_zicada/Kconfig.defconfig
```kconfig
# Copyright (c) 2024 Nordic Semiconductor ASA
# SPDX-License-Identifier: Apache-2.0

if BOARD_NRF52_ZICADA

config BOARD
	default "nrf52_zicada"

config BT_CTLR
   default BT

endif
```

## firmware/boards/arm/nrf52_zicada/nrf52_zicada_defconfig
```kconfig
# Copyright (c) 2024 Nordic Semiconductor ASA
# SPDX-License-Identifier: Apache-2.0

CONFIG_SOC_SERIES_NRF52X=y
CONFIG_SOC_NRF52840_QIAA=y
CONFIG_BOARD_NRF52_ZICADA=y

# Enable MPU
CONFIG_ARM_MPU=y

# Enable hardware stack protection
CONFIG_HW_STACK_PROTECTION=y

# enable GPIO
CONFIG_GPIO=y

CONFIG_PINCTRL=y

# # Enable nRF ECB driver
CONFIG_CRYPTO=y
CONFIG_CRYPTO_NRF_ECB=y
CONFIG_CRYPTO_INIT_PRIORITY=80

# # Networking
CONFIG_MPSL=y
```

## firmware/boards/arm/nrf52_zicada_rev1/Kconfig.board
```kconfig
# Copyright (c) 2024 Nordic Semiconductor ASA
# SPDX-License-Identifier: Apache-2.0

config BOARD_NRF52_ZICADA_REV1
	bool "nRF52840 Zicada Zigbee Node"
	depends on SOC_NRF52840_QIAA
```

## firmware/boards/arm/nrf52_zicada_rev1/Kconfig.defconfig
```kconfig
# Copyright (c) 2024 Nordic Semiconductor ASA
# SPDX-License-Identifier: Apache-2.0

if BOARD_NRF52_ZICADA_REV1

config BOARD
	default "nrf52_zicada_rev1"

config BT_CTLR
   default BT

endif
```
